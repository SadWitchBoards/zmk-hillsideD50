## boards/shields/hillside_d50/Kconfig.defconfig
```kconfig
if SHIELD_HILLSIDE_D50_LEFT

config ZMK_KEYBOARD_NAME
    default "Hillside D50"

config ZMK_SPLIT_ROLE_CENTRAL
    default y

endif

if SHIELD_HILLSIDE_D50_LEFT || SHIELD_HILLSIDE_D50_RIGHT

config ZMK_SPLIT
    default y

endif
```

## boards/shields/hillside_d50/Kconfig.shield
```kconfig
config SHIELD_HILLSIDE_D50_LEFT
    def_bool $(shields_list_contains,hillside_d50_left)

config SHIELD_HILLSIDE_D50_RIGHT
    def_bool $(shields_list_contains,hillside_d50_right)
```
